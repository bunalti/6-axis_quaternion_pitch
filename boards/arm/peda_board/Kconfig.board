## boards/arm/peda_board/Kconfig.board
```kconfig
# Copyright (c) 2022 Nordic Semiconductor ASA
# SPDX-License-Identifier: Apache-2.0

config BOARD_PEDAL_BOARD
	bool "pedal_board"
	depends on SOC_NRF52832_QFAA
```

## boards/arm/peda_board/Kconfig.defconfig
```kconfig
# Copyright (c) 2022 Nordic Semiconductor ASA
# SPDX-License-Identifier: Apache-2.0

if BOARD_PEDAL_BOARD

config BOARD
	default "pedal_board"

config BT_CTLR
   default BT

endif
```

## boards/arm/peda_board/pedal_board_defconfig
```kconfig
# Copyright (c) 2022 Nordic Semiconductor ASA
# SPDX-License-Identifier: Apache-2.0

CONFIG_SOC_SERIES_NRF52X=y
CONFIG_SOC_NRF52832_QFAA=y
CONFIG_BOARD_PEDAL_BOARD=y

# Enable MPU
CONFIG_ARM_MPU=y

# enable GPIO
CONFIG_GPIO=y
# additional board options
CONFIG_GPIO_AS_PINRESET=n
# Enable hardware stack protection
CONFIG_HW_STACK_PROTECTION=y

# Console
CONFIG_UART_CONSOLE=n
CONFIG_CONSOLE=y
CONFIG_USE_SEGGER_RTT=y
CONFIG_RTT_CONSOLE=y
CONFIG_LOG=y
CONFIG_LOG_MODE_DEFERRED=y
CONFIG_LOG_DEFAULT_LEVEL=4
CONFIG_LOG_BACKEND_RTT=y
CONFIG_LOG_BACKEND_RTT_BUFFER=0

# Heap memory
CONFIG_HEAP_MEM_POOL_SIZE=2048
# Some command handlers require a large stack.
CONFIG_SYSTEM_WORKQUEUE_STACK_SIZE=4096

# IMU Stuff...:
CONFIG_SPI=y
CONFIG_MAIN_STACK_SIZE=4096
# IMU 6-axis fusion (enables inclusion of 'math.h' library)
CONFIG_NEWLIB_LIBC=y
CONFIG_CBPRINTF_FP_SUPPORT=y
CONFIG_NEWLIB_LIBC_FLOAT_PRINTF=y
# additional board options
CONFIG_GPIO_AS_PINRESET=n

# debugging
CONFIG_DEBUG_OPTIMIZATIONS=y
CONFIG_DEBUG_THREAD_INFO=y
#esb
CONFIG_NCS_SAMPLES_DEFAULTS=y
CONFIG_ESB=y



# Beyond base settings
#CONFIG_SPI_NRFX=y
#CONFIG_NRFX_SPI1=y
#CONFIG_NRFX_SPIM1=y
#CONFIG_SPI_NRFX=y
#CONFIG_SPI_NRFX_RAM_BUFFER_SIZE=16
CONFIG_DISK_DRIVER_SDMMC=y
CONFIG_SDMMC_LOG_LEVEL_DBG=n
CONFIG_FILE_SYSTEM=y
CONFIG_FAT_FILESYSTEM_ELM=y
CONFIG_FS_FATFS_EXFAT=y
CONFIG_FS_FATFS_LFN=y
#CONFIG_SPI_3=y
#CONFIG_NRFX_SPIM3=y
```

## build/Kconfig/Kconfig.shield
```kconfig
osource "c:/Users/kerem/Desktop/temp/6-axis_quaternion_pitch/boards/shields/*/Kconfig.shield"
osource "C:/ncs/v1.9.1/nrf/boards/shields/*/Kconfig.shield"
```
